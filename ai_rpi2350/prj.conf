## CMakeLists.txt
```
# SPDX-License-Identifier: Apache-2.0
# TFLite-Micro sine-demo application — Zephyr / Raspberry Pi Pico 2 W (RP2350)

cmake_minimum_required(VERSION 3.20.0)

find_package(Zephyr REQUIRED HINTS $ENV{ZEPHYR_BASE})
project(ai_mcu_tflm_sine)

# tflite-micro relies on local static initialization; Zephyr does not provide
# the C++ ABI for thread-safe initialization of local statics, and the
# constructors here do not require thread safety (same approach as Zephyr's
# samples/modules/tflite-micro/hello_world).
set(NO_THREADSAFE_STATICS $<TARGET_PROPERTY:compiler-cpp,no_threadsafe_statics>)
zephyr_compile_options($<$<COMPILE_LANGUAGE:CXX>:${NO_THREADSAFE_STATICS}>)

# The Pico's USB device driver still uses the legacy USB stack API, which
# emits deprecation warnings on Zephyr main (same as the gpio16_blinky
# sample they inspired this setup). Only silence them when the CDC ACM
# console is actually enabled (i.e. building for the Pico 2 W).
if(CONFIG_USB_CDC_ACM)
  zephyr_compile_options(-Wno-deprecated-declarations)
endif()

target_sources(app PRIVATE
  src/main.cpp
  src/sine_model_data.cc
)
```

## prj.conf
```kconfig
# C++ application (tflite-micro is a C++ library)
CONFIG_CPP=y
CONFIG_STD_CPP17=y

# TensorFlow Lite for Microcontrollers (west project 'tflite-micro',
# glue provided in-tree by zephyr/modules/tflite-micro)
CONFIG_TENSORFLOW_LITE_MICRO=y

# Head-room for setup + the C++ call chain (the tensor arena is static,
# so this only covers call frames).
CONFIG_MAIN_STACK_SIZE=4096

# printk("%f") support — used to print x_value/y_value.
CONFIG_REQUIRES_FLOAT_PRINTF=y
```

## boards/rpi_pico2_rp2350a_m33_w.conf
```kconfig
# USB CDC ACM console — board-specific (auto-applied by Zephyr for
# rpi_pico2/rp2350a/m33/w only; qemu_x86 keeps its regular console).
# Options mirror zephyr/samples/basic/pico2w_gpio16_blinky/prj.conf.
#
# The Pico 2 W enumerates as /dev/ttyACM* on the host and printk streams
# there; watch it with `make mcu_monitor`.

CONFIG_USB_DEVICE_STACK=y
CONFIG_USB_CDC_ACM=y
# Bring the USB device up at boot — the app never calls usb_enable().
CONFIG_USB_DEVICE_INITIALIZE_AT_BOOT=y
# Raspberry Pi VID/PID.
CONFIG_USB_DEVICE_VID=0x2E8A
CONFIG_USB_DEVICE_PID=0x000A
CONFIG_USB_DEVICE_PRODUCT="Pico2W TFLM Sine"

# Console plumbing over the CDC ACM UART instance.
CONFIG_SERIAL=y
CONFIG_CONSOLE=y
CONFIG_UART_CONSOLE=y
CONFIG_UART_INTERRUPT_DRIVEN=y
# Handle SET_LINE_CDC/LINE_CTRL so host terminals (minicom etc.) work
# seamlessly with the CDC port.
CONFIG_UART_LINE_CTRL=y
```

## boards/rpi_pico2_rp2350a_m33_w.overlay
```dts
/*
 * USB CDC ACM console for the Raspberry Pi Pico 2 W (RP2350).
 *
 * Inspired by zephyr/samples/basic/pico2w_gpio16_blinky/app.overlay —
 * the USB CDC ACM part only; the GPIO16 LED / buzzer nodes were dropped.
 *
 * Effect: the board's native USB port enumerates as a CDC ACM serial
 * device (Raspberry Pi VID 2E8A / PID 000A -> /dev/ttyACM* on the host)
 * and the Zephyr console (printk) is routed there — no UART adapter
 * needed, just the USB cable.
 *
 * Board-specific file: Zephyr auto-applies <app>/boards/<board>.overlay
 * only when building for rpi_pico2/rp2350a/m33/w, so the qemu_x86 smoke
 * test keeps its regular console.
 */

/ {
	/* Route the console to the CDC ACM UART instance below. */
	chosen {
		zephyr,console = &cdc_acm_uart0;
	};
};

/* CDC ACM UART instance under the Pico's USB device controller. */
&zephyr_udc0 {
	cdc_acm_uart0: cdc_acm_uart0 {
		compatible = "zephyr,cdc-acm-uart";
	};
};
```

## src/sine_model.h
```c
/*
 * model_int8.tflite — embedded TFLite-Micro model (GENERATED FILE, do not edit).
 *
 * Source : /home/aimlrn/ai_mcu/ai_rpi2350/model/model_int8.tflite
 * Bytes  : 3464
 * Regen  : make header        (model/tflite_to_cc.py)
 */


#ifndef AI_MCU_SINE_MODEL_H_
#define AI_MCU_SINE_MODEL_H_

#ifdef __cplusplus
extern "C" {
#endif

/* Raw TFLite flatbuffer; consumed with tflite::GetModel(g_sine_model). */
extern const unsigned char g_sine_model[];

/* Size of the flatbuffer in bytes. */
extern const int g_sine_model_len;

#ifdef __cplusplus
}
#endif

#endif /* AI_MCU_SINE_MODEL_H_ */
```

## src/sine_model_data.cc
```c
/*
 * model_int8.tflite — embedded TFLite-Micro model (GENERATED FILE, do not edit).
 *
 * Source : /home/aimlrn/ai_mcu/ai_rpi2350/model/model_int8.tflite
 * Bytes  : 3464
 * Regen  : make header        (model/tflite_to_cc.py)
 */


#include "sine_model.h"

alignas(16) const unsigned char g_sine_model[] = {
	0x20, 0x00, 0x00, 0x00, 0x54, 0x46, 0x4c, 0x33, 0x00, 0x00, 0x00, 0x00,
	0x14, 0x00, 0x20, 0x00, 0x1c, 0x00, 0x18, 0x00, 0x14, 0x00, 0x10, 0x00,
	0x0c, 0x00, 0x00, 0x00, 0x08, 0x00, 0x04, 0x00, 0x14, 0x00, 0x00, 0x00,
	0x1c, 0x00, 0x00, 0x00, 0x98, 0x00, 0x00, 0x00, 0xf0, 0x00, 0x00, 0x00,
	0xb4, 0x03, 0x00, 0x00, 0xc4, 0x03, 0x00, 0x00, 0x2c, 0x0d, 0x00, 0x00,
	0x03, 0x00, 0x00, 0x00, 0x01, 0x00, 0x00, 0x00, 0x10, 0x00, 0x00, 0x00,
	0x00, 0x00, 0x0a, 0x00, 0x10, 0x00, 0x0c, 0x00, 0x08, 0x00, 0x04, 0x00,
	0x0a, 0x00, 0x00, 0x00, 0x0c, 0x00, 0x00, 0x00, 0x1c, 0x00, 0x00, 0x00,
	0x3c, 0x00, 0x00, 0x00, 0x0f, 0x00, 0x00, 0x00, 0x73, 0x65, 0x72, 0x76,
	0x69, 0x6e, 0x67, 0x5f, 0x64, 0x65, 0x66, 0x61, 0x75, 0x6c, 0x74, 0x00,
	0x01, 0x00, 0x00, 0x00, 0x04, 0x00, 0x00, 0x00, 0x90, 0xff, 0xff, 0xff,
	0x09, 0x00, 0x00, 0x00, 0x04, 0x00, 0x00, 0x00, 0x08, 0x00, 0x00, 0x00,
	0x6f, 0x75, 0x74, 0x70, 0x75, 0x74, 0x5f, 0x30, 0x00, 0x00, 0x00, 0x00,
	0x01, 0x00, 0x00, 0x00, 0x04, 0x00, 0x00, 0x00, 0xde, 0xfc, 0xff, 0xff,
	0x04, 0x00, 0x00, 0x00, 0x0c, 0x00, 0x00, 0x00, 0x6b, 0x65, 0x72, 0x61,
	0x73, 0x5f, 0x74, 0x65, 0x6e, 0x73, 0x6f, 0x72, 0x00, 0x00, 0x00, 0x00,
	0x02, 0x00, 0x00, 0x00, 0x34, 0x00, 0x00, 0x00, 0x04, 0x00, 0x00, 0x00,
	0xdc, 0xff, 0xff, 0xff, 0x0c, 0x00, 0x00, 0x00, 0x04, 0x00, 0x00, 0x00,
	0x13, 0x00, 0x00, 0x00, 0x43, 0x4f, 0x4e, 0x56, 0x45, 0x52, 0x53, 0x49,
	0x4f, 0x4e, 0x5f, 0x4d, 0x45, 0x54, 0x41, 0x44, 0x41, 0x54, 0x41, 0x00,
	0x08, 0x00, 0x0c, 0x00, 0x08, 0x00, 0x04, 0x00, 0x08, 0x00, 0x00, 0x00,
	0x0b, 0x00, 0x00, 0x00, 0x04, 0x00, 0x00, 0x00, 0x13, 0x00, 0x00, 0x00,
	0x6d, 0x69, 0x6e, 0x5f, 0x72, 0x75, 0x6e, 0x74, 0x69, 0x6d, 0x65, 0x5f,
	0x76, 0x65, 0x72, 0x73, 0x69, 0x6f, 0x6e, 0x00, 0x0d, 0x00, 0x00, 0x00,
	0xc0, 0x02, 0x00, 0x00, 0xb8, 0x02, 0x00, 0x00, 0xa4, 0x02, 0x00, 0x00,
	0x7c, 0x02, 0x00, 0x00, 0x2c, 0x02, 0x00, 0x00, 0x1c, 0x01, 0x00, 0x00,
	0xcc, 0x00, 0x00, 0x00, 0xac, 0x00, 0x00, 0x00, 0xa4, 0x00, 0x00, 0x00,
	0x9c, 0x00, 0x00, 0x00, 0x94, 0x00, 0x00, 0x00, 0x74, 0x00, 0x00, 0x00,
	0x04, 0x00, 0x00, 0x00, 0x8e, 0xfd, 0xff, 0xff, 0x04, 0x00, 0x00, 0x00,
	0x60, 0x00, 0x00, 0x00, 0x0c, 0x00, 0x00, 0x00, 0x08, 0x00, 0x0e, 0x00,
	0x08, 0x00, 0x04, 0x00, 0x08, 0x00, 0x00, 0x00, 0x10, 0x00, 0x00, 0x00,
	0x28, 0x00, 0x00, 0x00, 0x00, 0x00, 0x06, 0x00, 0x08, 0x00, 0x04, 0x00,
	0x06, 0x00, 0x00, 0x00, 0x04, 0x00, 0x00, 0x00, 0x01, 0x00, 0x00, 0x00,
	0xeb, 0x03, 0x00, 0x00, 0x0c, 0x00, 0x18, 0x00, 0x14, 0x00, 0x10, 0x00,
	0x0c, 0x00, 0x04, 0x00, 0x0c, 0x00, 0x00, 0x00, 0x7f, 0x77, 0x1c, 0xdf,
	0x73, 0x60, 0x95, 0x39, 0x02, 0x00, 0x00, 0x00, 0x02, 0x00, 0x00, 0x00,
	0x04, 0x00, 0x00, 0x00, 0x06, 0x00, 0x00, 0x00, 0x32, 0x2e, 0x32, 0x31,
	0x2e, 0x30, 0x00, 0x00, 0xfa, 0xfd, 0xff, 0xff, 0x04, 0x00, 0x00, 0x00,
	0x10, 0x00, 0x00, 0x00, 0x31, 0x2e, 0x31, 0x34, 0x2e, 0x30, 0x00, 0x00,
	0x00, 0x00, 0x00, 0x00, 0x00, 0x00, 0x00, 0x00, 0x84, 0xfd, 0xff, 0xff,
	0x88, 0xfd, 0xff, 0xff, 0x8c, 0xfd, 0xff, 0xff, 0x22, 0xfe, 0xff, 0xff,
	0x04, 0x00, 0x00, 0x00, 0x10, 0x00, 0x00, 0x00, 0x81, 0x81, 0x81, 0x81,
	0x81, 0x81, 0x7f, 0x81, 0x81, 0x81, 0x7f, 0x81, 0x81, 0x81, 0x81, 0x81,
	0x3e, 0xfe, 0xff, 0xff, 0x04, 0x00, 0x00, 0x00, 0x40, 0x00, 0x00, 0x00,
	0x00, 0x00, 0x00, 0x00, 0x00, 0x00, 0x00, 0x00, 0x00, 0x00, 0x00, 0x00,
	0xae, 0x64, 0x01, 0x00, 0x00, 0x00, 0x00, 0x00, 0x00, 0x00, 0x00, 0x00,
	0x0b, 0x00, 0x00, 0x00, 0x00, 0x00, 0x00, 0x00, 0x00, 0x00, 0x00, 0x00,
	0x00, 0x00, 0x00, 0x00, 0x68, 0xee, 0xff, 0xff, 0x00, 0x00, 0x00, 0x00,
	0xb2, 0x13, 0x01, 0x00, 0xc2, 0x37, 0x04, 0x00, 0x64, 0x8e, 0x00, 0x00,
	0x00, 0x00, 0x00, 0x00, 0x8a, 0xfe, 0xff, 0xff, 0x04, 0x00, 0x00, 0x00,
	0x00, 0x01, 0x00, 0x00, 0x36, 0x22, 0x14, 0x5e, 0xca, 0x1a, 0xb6, 0x25,
	0x35, 0x2a, 0xee, 0xe0, 0x57, 0x7f, 0x4a, 0xc2, 0x03, 0x45, 0x3c, 0x24,
	0xc5, 0xce, 0x81, 0x3b, 0xf0, 0xdc, 0x0d, 0xbb, 0x67, 0xf9, 0x44, 0x36,
	0x0a, 0x6e, 0xf7, 0x70, 0x2a, 0x87, 0x91, 0xde, 0x72, 0x5e, 0x81, 0xcc,
	0xa4, 0x89, 0xca, 0x8f, 0xea, 0x15, 0xd5, 0x1c, 0xb3, 0x28, 0xf0, 0xa3,
	0xf0, 0x42, 0x4f, 0x4f, 0x81, 0xc9, 0xbd, 0x2f, 0xa2, 0x2a, 0x93, 0xa5,
	0xf6, 0x81, 0xdc, 0xed, 0xfb, 0xa1, 0x87, 0x62, 0xdb, 0x68, 0xc8, 0xaf,
	0x97, 0x4e, 0xb2, 0x96, 0xbb, 0x72, 0x22, 0xff, 0xa5, 0x0e, 0x7f, 0x1b,
	0xd3, 0xf6, 0xd5, 0xc4, 0xd4, 0x32, 0x23, 0x7f, 0xfb, 0x21, 0x1a, 0xef,
	0xd6, 0x14, 0x15, 0xc8, 0x5a, 0x58, 0x28, 0xb1, 0x16, 0xd4, 0x42, 0x42,
	0x1d, 0xeb, 0xe4, 0xf3, 0xec, 0x17, 0x94, 0xc5, 0x25, 0x7f, 0x7f, 0xf5,
	0x76, 0xd0, 0x07, 0xdf, 0x53, 0xf1, 0xd0, 0x92, 0xf0, 0x6b, 0xc9, 0x79,
	0x81, 0xfa, 0xb3, 0xa3, 0x2e, 0xce, 0x0d, 0xf6, 0x1a, 0x15, 0xf8, 0xe7,
	0x3d, 0xe2, 0x0f, 0xc5, 0x5f, 0x7f, 0x53, 0xf6, 0x41, 0xf3, 0xec, 0x57,
	0x1a, 0xbf, 0xcf, 0x30, 0x01, 0x69, 0xa6, 0x67, 0xe7, 0x43, 0x81, 0x00,
	0xd6, 0xec, 0x1f, 0x1e, 0x1c, 0xf9, 0x81, 0xdd, 0x03, 0x14, 0x0c, 0x18,
	0x1d, 0xef, 0x40, 0x2e, 0xe2, 0xf8, 0xef, 0xb0, 0xe5, 0x20, 0x0e, 0xe8,
	0xfb, 0x0a, 0x34, 0xff, 0xb7, 0xf4, 0x81, 0xf4, 0xb4, 0x81, 0xcd, 0x5c,
	0x64, 0xff, 0x25, 0x74, 0x0e, 0x16, 0x41, 0xfc, 0xdd, 0xf0, 0x67, 0xcc,
	0x2c, 0x35, 0xe5, 0xdb, 0xd4, 0xd4, 0x27, 0xc8, 0xb1, 0x52, 0x1c, 0xf0,
	0xf9, 0xee, 0x7f, 0xef, 0x0b, 0xc0, 0xc3, 0x0c, 0x07, 0xee, 0x81, 0xdb,
	0xcc, 0xf5, 0xf0, 0x3e, 0x63, 0x59, 0x0b, 0x40, 0x96, 0xff, 0xff, 0xff,
	0x04, 0x00, 0x00, 0x00, 0x40, 0x00, 0x00, 0x00, 0xa6, 0x18, 0x00, 0x00,
	0x28, 0x11, 0x00, 0x00, 0x00, 0x00, 0x00, 0x00, 0x0d, 0xee, 0xff, 0xff,
	0x00, 0x00, 0x00, 0x00, 0x0d, 0xf1, 0xff, 0xff, 0x39, 0x04, 0x00, 0x00,
	0x33, 0x1a, 0x00, 0x00, 0x00, 0x00, 0x00, 0x00, 0xf1, 0x09, 0x00, 0x00,
	0x00, 0x00, 0x00, 0x00, 0x17, 0x09, 0x00, 0x00, 0x09, 0xf0, 0xff, 0xff,
	0x14, 0x0f, 0x00, 0x00, 0xad, 0x0a, 0x00, 0x00, 0x68, 0x0f, 0x00, 0x00,
	0xe2, 0xff, 0xff, 0xff, 0x04, 0x00, 0x00, 0x00, 0x10, 0x00, 0x00, 0x00,
	0x7f, 0x90, 0xe5, 0x3a, 0x01, 0x44, 0xf7, 0x6e, 0x1d, 0xd9, 0xef, 0xab,
	0x79, 0xe5, 0xca, 0xa9, 0x00, 0x00, 0x06, 0x00, 0x08, 0x00, 0x04, 0x00,
	0x06, 0x00, 0x00, 0x00, 0x04, 0x00, 0x00, 0x00, 0x04, 0x00, 0x00, 0x00,
	0x1a, 0xf7, 0xff, 0xff, 0x84, 0xff, 0xff, 0xff, 0x88, 0xff, 0xff, 0xff,
	0x0f, 0x00, 0x00, 0x00, 0x4d, 0x4c, 0x49, 0x52, 0x20, 0x43, 0x6f, 0x6e,
	0x76, 0x65, 0x72, 0x74, 0x65, 0x64, 0x2e, 0x00, 0x01, 0x00, 0x00, 0x00,
	0x14, 0x00, 0x00, 0x00, 0x00, 0x00, 0x0e, 0x00, 0x18, 0x00, 0x14, 0x00,
	0x10, 0x00, 0x0c, 0x00, 0x08, 0x00, 0x04, 0x00, 0x0e, 0x00, 0x00, 0x00,
	0x14, 0x00, 0x00, 0x00, 0x1c, 0x00, 0x00, 0x00, 0xec, 0x00, 0x00, 0x00,
	0xf0, 0x00, 0x00, 0x00, 0xf4, 0x00, 0x00, 0x00, 0x04, 0x00, 0x00, 0x00,
	0x6d, 0x61, 0x69, 0x6e, 0x00, 0x00, 0x00, 0x00, 0x03, 0x00, 0x00, 0x00,
	0x94, 0x00, 0x00, 0x00, 0x4c, 0x00, 0x00, 0x00, 0x04, 0x00, 0x00, 0x00,
	0xca, 0xff, 0xff, 0xff, 0x14, 0x00, 0x00, 0x00, 0x00, 0x00, 0x00, 0x08,
	0x10, 0x00, 0x00, 0x00, 0x14, 0x00, 0x00, 0x00, 0x04, 0x00, 0x04, 0x00,
	0x04, 0x00, 0x00, 0x00, 0x01, 0x00, 0x00, 0x00, 0x09, 0x00, 0x00, 0x00,
	0x03, 0x00, 0x00, 0x00, 0x08, 0x00, 0x00, 0x00, 0x02, 0x00, 0x00, 0x00,
	0x01, 0x00, 0x00, 0x00, 0x00, 0x00, 0x0e, 0x00, 0x14, 0x00, 0x00, 0x00,
	0x10, 0x00, 0x0c, 0x00, 0x0b, 0x00, 0x04, 0x00, 0x0e, 0x00, 0x00, 0x00,
	0x10, 0x00, 0x00, 0x00, 0x00, 0x00, 0x00, 0x08, 0x10, 0x00, 0x00, 0x00,
	0x14, 0x00, 0x00, 0x00, 0xba, 0xff, 0xff, 0xff, 0x00, 0x00, 0x00, 0x01,
	0x01, 0x00, 0x00, 0x00, 0x08, 0x00, 0x00, 0x00, 0x03, 0x00, 0x00, 0x00,
	0x07, 0x00, 0x00, 0x00, 0x04, 0x00, 0x00, 0x00, 0x03, 0x00, 0x00, 0x00,
	0x00, 0x00, 0x0e, 0x00, 0x16, 0x00, 0x00, 0x00, 0x10, 0x00, 0x0c, 0x00,
	0x0b, 0x00, 0x04, 0x00, 0x0e, 0x00, 0x00, 0x00, 0x18, 0x00, 0x00, 0x00,
	0x00, 0x00, 0x00, 0x08, 0x18, 0x00, 0x00, 0x00, 0x1c, 0x00, 0x00, 0x00,
	0x00, 0x00, 0x06, 0x00, 0x08, 0x00, 0x07, 0x00, 0x06, 0x00, 0x00, 0x00,
	0x00, 0x00, 0x00, 0x01, 0x01, 0x00, 0x00, 0x00, 0x07, 0x00, 0x00, 0x00,
	0x03, 0x00, 0x00, 0x00, 0x00, 0x00, 0x00, 0x00, 0x06, 0x00, 0x00, 0x00,
	0x05, 0x00, 0x00, 0x00, 0x01, 0x00, 0x00, 0x00, 0x09, 0x00, 0x00, 0x00,
	0x01, 0x00, 0x00, 0x00, 0x00, 0x00, 0x00, 0x00, 0x0a, 0x00, 0x00, 0x00,
	0xbc, 0x07, 0x00, 0x00, 0x3c, 0x07, 0x00, 0x00, 0xb0, 0x06, 0x00, 0x00,
	0x74, 0x05, 0x00, 0x00, 0x50, 0x04, 0x00, 0x00, 0x14, 0x03, 0x00, 0x00,
	0xf0, 0x01, 0x00, 0x00, 0x3c, 0x01, 0x00, 0x00, 0x80, 0x00, 0x00, 0x00,
	0x04, 0x00, 0x00, 0x00, 0x82, 0xf8, 0xff, 0xff, 0x00, 0x00, 0x00, 0x01,
	0x18, 0x00, 0x00, 0x00, 0x20, 0x00, 0x00, 0x00, 0x3c, 0x00, 0x00, 0x00,
	0x0a, 0x00, 0x00, 0x00, 0x00, 0x00, 0x00, 0x09, 0x50, 0x00, 0x00, 0x00,
	0x02, 0x00, 0x00, 0x00, 0xff, 0xff, 0xff, 0xff, 0x01, 0x00, 0x00, 0x00,
	0x6c, 0xf8, 0xff, 0xff, 0x08, 0x00, 0x00, 0x00, 0x10, 0x00, 0x00, 0x00,
	0x01, 0x00, 0x00, 0x00, 0x00, 0x00, 0x00, 0x00, 0x00, 0x00, 0x00, 0x00,
	0x01, 0x00, 0x00, 0x00, 0x5d, 0x5a, 0x02, 0x3c, 0x1b, 0x00, 0x00, 0x00,
	0x53, 0x74, 0x61, 0x74, 0x65, 0x66, 0x75, 0x6c, 0x50, 0x61, 0x72, 0x74,
	0x69, 0x74, 0x69, 0x6f, 0x6e, 0x65, 0x64, 0x43, 0x61, 0x6c, 0x6c, 0x5f,
	0x31, 0x3a, 0x30, 0x00, 0x02, 0x00, 0x00, 0x00, 0x01, 0x00, 0x00, 0x00,
	0x01, 0x00, 0x00, 0x00, 0xfa, 0xf8, 0xff, 0xff, 0x00, 0x00, 0x00, 0x01,
	0x18, 0x00, 0x00, 0x00, 0x20, 0x00, 0x00, 0x00, 0x3c, 0x00, 0x00, 0x00,
	0x09, 0x00, 0x00, 0x00, 0x00, 0x00, 0x00, 0x09, 0x90, 0x00, 0x00, 0x00,
	0x02, 0x00, 0x00, 0x00, 0xff, 0xff, 0xff, 0xff, 0x10, 0x00, 0x00, 0x00,
	0xe4, 0xf8, 0xff, 0xff, 0x08, 0x00, 0x00, 0x00, 0x10, 0x00, 0x00, 0x00,
	0x01, 0x00, 0x00, 0x00, 0x80, 0xff, 0xff, 0xff, 0xff, 0xff, 0xff, 0xff,
	0x01, 0x00, 0x00, 0x00, 0x83, 0xd0, 0x01, 0x3c, 0x58, 0x00, 0x00, 0x00,
	0x73, 0x65, 0x71, 0x75, 0x65, 0x6e, 0x74, 0x69, 0x61, 0x6c, 0x5f, 0x31,
	0x2f, 0x64, 0x65, 0x6e, 0x73, 0x65, 0x5f, 0x31, 0x5f, 0x32, 0x2f, 0x4d,
	0x61, 0x74, 0x4d, 0x75, 0x6c, 0x3b, 0x73, 0x65, 0x71, 0x75, 0x65, 0x6e,
	0x74, 0x69, 0x61, 0x6c, 0x5f, 0x31, 0x2f, 0x64, 0x65, 0x6e, 0x73, 0x65,
	0x5f, 0x31, 0x5f, 0x32, 0x2f, 0x52, 0x65, 0x6c, 0x75, 0x3b, 0x73, 0x65,
	0x71, 0x75, 0x65, 0x6e, 0x74, 0x69, 0x61, 0x6c, 0x5f, 0x31, 0x2f, 0x64,
	0x65, 0x6e, 0x73, 0x65, 0x5f, 0x31, 0x5f, 0x32, 0x2f, 0x42, 0x69, 0x61,
	0x73, 0x41, 0x64, 0x64, 0x00, 0x00, 0x00, 0x00, 0x02, 0x00, 0x00, 0x00,
	0x01, 0x00, 0x00, 0x00, 0x10, 0x00, 0x00, 0x00, 0xb2, 0xf9, 0xff, 0xff,
	0x00, 0x00, 0x00, 0x01, 0x18, 0x00, 0x00, 0x00, 0x20, 0x00, 0x00, 0x00,
	0x3c, 0x00, 0x00, 0x00, 0x08, 0x00, 0x00, 0x00, 0x00, 0x00, 0x00, 0x09,
	0x88, 0x00, 0x00, 0x00, 0x02, 0x00, 0x00, 0x00, 0xff, 0xff, 0xff, 0xff,
	0x10, 0x00, 0x00, 0x00, 0x9c, 0xf9, 0xff, 0xff, 0x08, 0x00, 0x00, 0x00,
	0x10, 0x00, 0x00, 0x00, 0x01, 0x00, 0x00, 0x00, 0x80, 0xff, 0xff, 0xff,
	0xff, 0xff, 0xff, 0xff, 0x01, 0x00, 0x00, 0x00, 0xfc, 0xe6, 0x5f, 0x3c,
	0x52, 0x00, 0x00, 0x00, 0x73, 0x65, 0x71, 0x75, 0x65, 0x6e, 0x74, 0x69,
	0x61, 0x6c, 0x5f, 0x31, 0x2f, 0x64, 0x65, 0x6e, 0x73, 0x65, 0x5f, 0x31,
	0x2f, 0x4d, 0x61, 0x74, 0x4d, 0x75, 0x6c, 0x3b, 0x73, 0x65, 0x71, 0x75,
	0x65, 0x6e, 0x74, 0x69, 0x61, 0x6c, 0x5f, 0x31, 0x2f, 0x64, 0x65, 0x6e,
	0x73, 0x65, 0x5f, 0x31, 0x2f, 0x52, 0x65, 0x6c, 0x75, 0x3b, 0x73, 0x65,
	0x71, 0x75, 0x65, 0x6e, 0x74, 0x69, 0x61, 0x6c, 0x5f, 0x31, 0x2f, 0x64,
	0x65, 0x6e, 0x73, 0x65, 0x5f, 0x31, 0x2f, 0x42, 0x69, 0x61, 0x73, 0x41,
	0x64, 0x64, 0x00, 0x00, 0x02, 0x00, 0x00, 0x00, 0x01, 0x00, 0x00, 0x00,
	0x10, 0x00, 0x00, 0x00, 0xde, 0xfa, 0xff, 0xff, 0x00, 0x00, 0x00, 0x01,
	0x14, 0x00, 0x00, 0x00, 0xe8, 0x00, 0x00, 0x00, 0x07, 0x00, 0x00, 0x00,
	0x00, 0x00, 0x00, 0x09, 0xfc, 0x00, 0x00, 0x00, 0x3c, 0xfa, 0xff, 0xff,
	0x08, 0x00, 0x00, 0x00, 0x8c, 0x00, 0x00, 0x00, 0x10, 0x00, 0x00, 0x00,
	0x00, 0x00, 0x00, 0x00, 0x00, 0x00, 0x00, 0x00, 0x00, 0x00, 0x00, 0x00,
	0x00, 0x00, 0x00, 0x00, 0x00, 0x00, 0x00, 0x00, 0x00, 0x00, 0x00, 0x00,
	0x00, 0x00, 0x00, 0x00, 0x00, 0x00, 0x00, 0x00, 0x00, 0x00, 0x00, 0x00,
	0x00, 0x00, 0x00, 0x00, 0x00, 0x00, 0x00, 0x00, 0x00, 0x00, 0x00, 0x00,
	0x00, 0x00, 0x00, 0x00, 0x00, 0x00, 0x00, 0x00, 0x00, 0x00, 0x00, 0x00,
	0x00, 0x00, 0x00, 0x00, 0x00, 0x00, 0x00, 0x00, 0x00, 0x00, 0x00, 0x00,
	0x00, 0x00, 0x00, 0x00, 0x00, 0x00, 0x00, 0x00, 0x00, 0x00, 0x00, 0x00,
	0x00, 0x00, 0x00, 0x00, 0x00, 0x00, 0x00, 0x00, 0x00, 0x00, 0x00, 0x00,
	0x00, 0x00, 0x00, 0x00, 0x00, 0x00, 0x00, 0x00, 0x00, 0x00, 0x00, 0x00,
	0x00, 0x00, 0x00, 0x00, 0x00, 0x00, 0x00, 0x00, 0x00, 0x00, 0x00, 0x00,
	0x00, 0x00, 0x00, 0x00, 0x00, 0x00, 0x00, 0x00, 0x00, 0x00, 0x00, 0x00,
	0x10, 0x00, 0x00, 0x00, 0x6b, 0x73, 0xf2, 0x3a, 0x41, 0xa2, 0x7c, 0x3a,
	0xa3, 0xd1, 0xa2, 0x37, 0x71, 0x83, 0x7a, 0x39, 0xb6, 0x93, 0x8a, 0x3b,
	0xc6, 0x94, 0x4e, 0x3a, 0x42, 0x57, 0x8f, 0x3b, 0x56, 0x90, 0x09, 0x3b,
	0x80, 0xb3, 0x15, 0x3b, 0x09, 0x71, 0x0f, 0x3b, 0x05, 0x9b, 0x76, 0x3b,
	0xde, 0x0f, 0xdb, 0x3a, 0x66, 0x4b, 0xda, 0x39, 0xb0, 0x3d, 0x2f, 0x38,
	0x26, 0x22, 0x69, 0x3a, 0xe0, 0x36, 0x92, 0x3b, 0x1b, 0x00, 0x00, 0x00,
	0x73, 0x65, 0x71, 0x75, 0x65, 0x6e, 0x74, 0x69, 0x61, 0x6c, 0x5f, 0x31,
	0x2f, 0x64, 0x65, 0x6e, 0x73, 0x65, 0x5f, 0x31, 0x2f, 0x4d, 0x61, 0x74,
	0x4d, 0x75, 0x6c, 0x00, 0x02, 0x00, 0x00, 0x00, 0x10, 0x00, 0x00, 0x00,
	0x01, 0x00, 0x00, 0x00, 0xfe, 0xfb, 0xff, 0xff, 0x00, 0x00, 0x00, 0x01,
	0x14, 0x00, 0x00, 0x00, 0xe8, 0x00, 0x00, 0x00, 0x06, 0x00, 0x00, 0x00,
	0x00, 0x00, 0x00, 0x02, 0x18, 0x01, 0x00, 0x00, 0x5c, 0xfb, 0xff, 0xff,
	0x08, 0x00, 0x00, 0x00, 0x8c, 0x00, 0x00, 0x00, 0x10, 0x00, 0x00, 0x00,
	0x00, 0x00, 0x00, 0x00, 0x00, 0x00, 0x00, 0x00, 0x00, 0x00, 0x00, 0x00,
	0x00, 0x00, 0x00, 0x00, 0x00, 0x00, 0x00, 0x00, 0x00, 0x00, 0x00, 0x00,
	0x00, 0x00, 0x00, 0x00, 0x00, 0x00, 0x00, 0x00, 0x00, 0x00, 0x00, 0x00,
	0x00, 0x00, 0x00, 0x00, 0x00, 0x00, 0x00, 0x00, 0x00, 0x00, 0x00, 0x00,
	0x00, 0x00, 0x00, 0x00, 0x00, 0x00, 0x00, 0x00, 0x00, 0x00, 0x00, 0x00,
	0x00, 0x00, 0x00, 0x00, 0x00, 0x00, 0x00, 0x00, 0x00, 0x00, 0x00, 0x00,
	0x00, 0x00, 0x00, 0x00, 0x00, 0x00, 0x00, 0x00, 0x00, 0x00, 0x00, 0x00,
	0x00, 0x00, 0x00, 0x00, 0x00, 0x00, 0x00, 0x00, 0x00, 0x00, 0x00, 0x00,
	0x00, 0x00, 0x00, 0x00, 0x00, 0x00, 0x00, 0x00, 0x00, 0x00, 0x00, 0x00,
	0x00, 0x00, 0x00, 0x00, 0x00, 0x00, 0x00, 0x00, 0x00, 0x00, 0x00, 0x00,
	0x00, 0x00, 0x00, 0x00, 0x00, 0x00, 0x00, 0x00, 0x00, 0x00, 0x00, 0x00,
	0x10, 0x00, 0x00, 0x00, 0xd4, 0xc8, 0x3e, 0x38, 0x25, 0xcc, 0xc6, 0x37,
	0x44, 0x1f, 0x00, 0x35, 0x02, 0x21, 0xc5, 0x36, 0xa6, 0x17, 0xda, 0x38,
	0x02, 0x8f, 0xa2, 0x37, 0xf8, 0x96, 0xe1, 0x38, 0x71, 0x7f, 0x58, 0x38,
	0x7f, 0x99, 0x6b, 0x38, 0x8a, 0xbf, 0x61, 0x38, 0xc7, 0x0d, 0xc2, 0x38,
	0x3a, 0x61, 0x2c, 0x38, 0xa0, 0xc6, 0x2b, 0x37, 0xa5, 0xe5, 0x89, 0x35,
	0xdc, 0x73, 0xb7, 0x37, 0xaf, 0x1c, 0xe6, 0x38, 0x36, 0x00, 0x00, 0x00,
	0x73, 0x65, 0x71, 0x75, 0x65, 0x6e, 0x74, 0x69, 0x61, 0x6c, 0x5f, 0x31,
	0x2f, 0x64, 0x65, 0x6e, 0x73, 0x65, 0x5f, 0x31, 0x2f, 0x52, 0x65, 0x6c,
	0x75, 0x3b, 0x73, 0x65, 0x71, 0x75, 0x65, 0x6e, 0x74, 0x69, 0x61, 0x6c,
	0x5f, 0x31, 0x2f, 0x64, 0x65, 0x6e, 0x73, 0x65, 0x5f, 0x31, 0x2f, 0x42,
	0x69, 0x61, 0x73, 0x41, 0x64, 0x64, 0x00, 0x00, 0x01, 0x00, 0x00, 0x00,
	0x10, 0x00, 0x00, 0x00, 0x36, 0xfd, 0xff, 0xff, 0x00, 0x00, 0x00, 0x01,
	0x14, 0x00, 0x00, 0x00, 0xe4, 0x00, 0x00, 0x00, 0x05, 0x00, 0x00, 0x00,
	0x00, 0x00, 0x00, 0x09, 0xfc, 0x00, 0x00, 0x00, 0x94, 0xfc, 0xff, 0xff,
	0x08, 0x00, 0x00, 0x00, 0x88, 0x00, 0x00, 0x00, 0x10, 0x00, 0x00, 0x00,
	0x00, 0x00, 0x00, 0x00, 0x00, 0x00, 0x00, 0x00, 0x00, 0x00, 0x00, 0x00,
	0x00, 0x00, 0x00, 0x00, 0x00, 0x00, 0x00, 0x00, 0x00, 0x00, 0x00, 0x00,
	0x00, 0x00, 0x00, 0x00, 0x00, 0x00, 0x00, 0x00, 0x00, 0x00, 0x00, 0x00,
	0x00, 0x00, 0x00, 0x00, 0x00, 0x00, 0x00, 0x00, 0x00, 0x00, 0x00, 0x00,
	0x00, 0x00, 0x00, 0x00, 0x00, 0x00, 0x00, 0x00, 0x00, 0x00, 0x00, 0x00,
	0x00, 0x00, 0x00, 0x00, 0x00, 0x00, 0x00, 0x00, 0x00, 0x00, 0x00, 0x00,
	0x00, 0x00, 0x00, 0x00, 0x00, 0x00, 0x00, 0x00, 0x00, 0x00, 0x00, 0x00,
	0x00, 0x00, 0x00, 0x00, 0x00, 0x00, 0x00, 0x00, 0x00, 0x00, 0x00, 0x00,
	0x00, 0x00, 0x00, 0x00, 0x00, 0x00, 0x00, 0x00, 0x00, 0x00, 0x00, 0x00,
	0x00, 0x00, 0x00, 0x00, 0x00, 0x00, 0x00, 0x00, 0x00, 0x00, 0x00, 0x00,
	0x00, 0x00, 0x00, 0x00, 0x00, 0x00, 0x00, 0x00, 0x10, 0x00, 0x00, 0x00,
	0x51, 0x9d, 0xe1, 0x3b, 0xb1, 0xf7, 0xb9, 0x3b, 0x54, 0x8c, 0x4c, 0x3b,
	0x96, 0x49, 0x8c, 0x3b, 0xb7, 0x65, 0x57, 0x3b, 0x54, 0x85, 0x75, 0x3b,
	0x6b, 0xeb, 0xb0, 0x3b, 0xe4, 0x3b, 0xaa, 0x3b, 0x47, 0x3f, 0x58, 0x3b,
	0x94, 0x1e, 0xc2, 0x3b, 0x38, 0xa4, 0x2b, 0x3b, 0x90, 0xe8, 0x09, 0x3c,
	0xc7, 0x2f, 0x14, 0x3c, 0x8e, 0x4f, 0x57, 0x3b, 0xef, 0x93, 0xa7, 0x3b,
	0xb2, 0xfc, 0xce, 0x3b, 0x1d, 0x00, 0x00, 0x00, 0x73, 0x65, 0x71, 0x75,
	0x65, 0x6e, 0x74, 0x69, 0x61, 0x6c, 0x5f, 0x31, 0x2f, 0x64, 0x65, 0x6e,
	0x73, 0x65, 0x5f, 0x31, 0x5f, 0x32, 0x2f, 0x4d, 0x61, 0x74, 0x4d, 0x75,
	0x6c, 0x00, 0x00, 0x00, 0x02, 0x00, 0x00, 0x00, 0x10, 0x00, 0x00, 0x00,
	0x10, 0x00, 0x00, 0x00, 0x56, 0xfe, 0xff, 0xff, 0x00, 0x00, 0x00, 0x01,
	0x14, 0x00, 0x00, 0x00, 0xe4, 0x00, 0x00, 0x00, 0x04, 0x00, 0x00, 0x00,
	0x00, 0x00, 0x00, 0x02, 0x18, 0x01, 0x00, 0x00, 0xb4, 0xfd, 0xff, 0xff,
	0x08, 0x00, 0x00, 0x00, 0x88, 0x00, 0x00, 0x00, 0x10, 0x00, 0x00, 0x00,
	0x00, 0x00, 0x00, 0x00, 0x00, 0x00, 0x00, 0x00, 0x00, 0x00, 0x00, 0x00,
	0x00, 0x00, 0x00, 0x00, 0x00, 0x00, 0x00, 0x00, 0x00, 0x00, 0x00, 0x00,
	0x00, 0x00, 0x00, 0x00, 0x00, 0x00, 0x00, 0x00, 0x00, 0x00, 0x00, 0x00,
	0x00, 0x00, 0x00, 0x00, 0x00, 0x00, 0x00, 0x00, 0x00, 0x00, 0x00, 0x00,
	0x00, 0x00, 0x00, 0x00, 0x00, 0x00, 0x00, 0x00, 0x00, 0x00, 0x00, 0x00,
	0x00, 0x00, 0x00, 0x00, 0x00, 0x00, 0x00, 0x00, 0x00, 0x00, 0x00, 0x00,
	0x00, 0x00, 0x00, 0x00, 0x00, 0x00, 0x00, 0x00, 0x00, 0x00, 0x00, 0x00,
	0x00, 0x00, 0x00, 0x00, 0x00, 0x00, 0x00, 0x00, 0x00, 0x00, 0x00, 0x00,
	0x00, 0x00, 0x00, 0x00, 0x00, 0x00, 0x00, 0x00, 0x00, 0x00, 0x00, 0x00,
	0x00, 0x00, 0x00, 0x00, 0x00, 0x00, 0x00, 0x00, 0x00, 0x00, 0x00, 0x00,
	0x00, 0x00, 0x00, 0x00, 0x00, 0x00, 0x00, 0x00, 0x10, 0x00, 0x00, 0x00,
	0x9b, 0x53, 0xc5, 0x38, 0x8f, 0xa6, 0xa2, 0x38, 0xcd, 0xe6, 0x32, 0x38,
	0x5c, 0x65, 0x75, 0x38, 0xf4, 0x63, 0x3c, 0x38, 0xac, 0xbc, 0x56, 0x38,
	0xb4, 0xbc, 0x9a, 0x38, 0xc5, 0xe3, 0x94, 0x38, 0x3d, 0x22, 0x3d, 0x38,
	0xc9, 0xc7, 0xa9, 0x38, 0xeb, 0x1e, 0x16, 0x38, 0x08, 0x3c, 0xf1, 0x38,
	0x53, 0x9b, 0x01, 0x39, 0x92, 0x50, 0x3c, 0x38, 0x11, 0x91, 0x92, 0x38,
	0xe2, 0x08, 0xb5, 0x38, 0x3a, 0x00, 0x00, 0x00, 0x73, 0x65, 0x71, 0x75,
	0x65, 0x6e, 0x74, 0x69, 0x61, 0x6c, 0x5f, 0x31, 0x2f, 0x64, 0x65, 0x6e,
	0x73, 0x65, 0x5f, 0x31, 0x5f, 0x32, 0x2f, 0x52, 0x65, 0x6c, 0x75, 0x3b,
	0x73, 0x65, 0x71, 0x75, 0x65, 0x6e, 0x74, 0x69, 0x61, 0x6c, 0x5f, 0x31,
	0x2f, 0x64, 0x65, 0x6e, 0x73, 0x65, 0x5f, 0x31, 0x5f, 0x32, 0x2f, 0x42,
	0x69, 0x61, 0x73, 0x41, 0x64, 0x64, 0x00, 0x00, 0x01, 0x00, 0x00, 0x00,
	0x10, 0x00, 0x00, 0x00, 0x8e, 0xff, 0xff, 0xff, 0x00, 0x00, 0x00, 0x01,
	0x14, 0x00, 0x00, 0x00, 0x34, 0x00, 0x00, 0x00, 0x03, 0x00, 0x00, 0x00,
	0x00, 0x00, 0x00, 0x09, 0x4c, 0x00, 0x00, 0x00, 0xec, 0xfe, 0xff, 0xff,
	0x08, 0x00, 0x00, 0x00, 0x14, 0x00, 0x00, 0x00, 0x01, 0x00, 0x00, 0x00,
	0x00, 0x00, 0x00, 0x00, 0x00, 0x00, 0x00, 0x00, 0x00, 0x00, 0x00, 0x00,
	0x01, 0x00, 0x00, 0x00, 0xe5, 0x2f, 0x2a, 0x3c, 0x1d, 0x00, 0x00, 0x00,
	0x73, 0x65, 0x71, 0x75, 0x65, 0x6e, 0x74, 0x69, 0x61, 0x6c, 0x5f, 0x31,
	0x2f, 0x64, 0x65, 0x6e, 0x73, 0x65, 0x5f, 0x32, 0x5f, 0x31, 0x2f, 0x4d,
	0x61, 0x74, 0x4d, 0x75, 0x6c, 0x00, 0x00, 0x00, 0x02, 0x00, 0x00, 0x00,
	0x01, 0x00, 0x00, 0x00, 0x10, 0x00, 0x00, 0x00, 0x00, 0x00, 0x16, 0x00,
	0x1c, 0x00, 0x18, 0x00, 0x17, 0x00, 0x10, 0x00, 0x0c, 0x00, 0x08, 0x00,
	0x00, 0x00, 0x00, 0x00, 0x00, 0x00, 0x07, 0x00, 0x16, 0x00, 0x00, 0x00,
	0x00, 0x00, 0x00, 0x01, 0x14, 0x00, 0x00, 0x00, 0x30, 0x00, 0x00, 0x00,
	0x02, 0x00, 0x00, 0x00, 0x00, 0x00, 0x00, 0x02, 0x44, 0x00, 0x00, 0x00,
	0x74, 0xff, 0xff, 0xff, 0x08, 0x00, 0x00, 0x00, 0x10, 0x00, 0x00, 0x00,
	0x01, 0x00, 0x00, 0x00, 0x00, 0x00, 0x00, 0x00, 0x00, 0x00, 0x00, 0x00,
	0x01, 0x00, 0x00, 0x00, 0x81, 0x99, 0xac, 0x38, 0x1a, 0x00, 0x00, 0x00,
	0x73, 0x65, 0x71, 0x75, 0x65, 0x6e, 0x74, 0x69, 0x61, 0x6c, 0x5f, 0x31,
	0x2f, 0x64, 0x65, 0x6e, 0x73, 0x65, 0x5f, 0x32, 0x5f, 0x31, 0x2f, 0x41,
	0x64, 0x64, 0x00, 0x00, 0x01, 0x00, 0x00, 0x00, 0x01, 0x00, 0x00, 0x00,
	0x00, 0x00, 0x16, 0x00, 0x20, 0x00, 0x1c, 0x00, 0x1b, 0x00, 0x14, 0x00,
	0x10, 0x00, 0x0c, 0x00, 0x00, 0x00, 0x00, 0x00, 0x08, 0x00, 0x07, 0x00,
	0x16, 0x00, 0x00, 0x00, 0x00, 0x00, 0x00, 0x01, 0x18, 0x00, 0x00, 0x00,
	0x2c, 0x00, 0x00, 0x00, 0x4c, 0x00, 0x00, 0x00, 0x01, 0x00, 0x00, 0x00,
	0x00, 0x00, 0x00, 0x09, 0x64, 0x00, 0x00, 0x00, 0x02, 0x00, 0x00, 0x00,
	0xff, 0xff, 0xff, 0xff, 0x01, 0x00, 0x00, 0x00, 0x0c, 0x00, 0x0c, 0x00,
	0x00, 0x00, 0x00, 0x00, 0x08, 0x00, 0x04, 0x00, 0x0c, 0x00, 0x00, 0x00,
	0x08, 0x00, 0x00, 0x00, 0x14, 0x00, 0x00, 0x00, 0x01, 0x00, 0x00, 0x00,
	0x80, 0xff, 0xff, 0xff, 0xff, 0xff, 0xff, 0xff, 0x00, 0x00, 0x00, 0x00,
	0x01, 0x00, 0x00, 0x00, 0x41, 0x72, 0xc9, 0x3c, 0x1e, 0x00, 0x00, 0x00,
	0x73, 0x65, 0x72, 0x76, 0x69, 0x6e, 0x67, 0x5f, 0x64, 0x65, 0x66, 0x61,
	0x75, 0x6c, 0x74, 0x5f, 0x6b, 0x65, 0x72, 0x61, 0x73, 0x5f, 0x74, 0x65,
	0x6e, 0x73, 0x6f, 0x72, 0x3a, 0x30, 0x00, 0x00, 0x02, 0x00, 0x00, 0x00,
	0x01, 0x00, 0x00, 0x00, 0x01, 0x00, 0x00, 0x00, 0x01, 0x00, 0x00, 0x00,
	0x10, 0x00, 0x00, 0x00, 0x0c, 0x00, 0x10, 0x00, 0x0f, 0x00, 0x00, 0x00,
	0x08, 0x00, 0x04, 0x00, 0x0c, 0x00, 0x00, 0x00, 0x09, 0x00, 0x00, 0x00,
	0x04, 0x00, 0x00, 0x00, 0x00, 0x00, 0x00, 0x09
};

const int g_sine_model_len = 3464;
```
